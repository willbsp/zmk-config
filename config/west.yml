## config/west.yml
```yaml
manifest:
  remotes:
    - name: zmkfirmware
      url-base: https://github.com/zmkfirmware
    - name: willbsp
      url-base: https://github.com/willbsp
  projects:
    - name: zmk
      remote: zmkfirmware
      revision: v0.3
      import: app/west.yml
    - name: nice-view-custom
      remote: willbsp
      revision: main
  self:
    path: config
```
